## src/examples/motor_command/Kconfig
```kconfig
menuconfig EXAMPLES_MOTOR_COMMAND
	bool "motor_command_main"
	default n
	---help---
```

## src/examples/smf_hw_stand/Kconfig
```kconfig
menuconfig EXAMPLES_SMF_HW_STAND
	bool "smf_hw_stand"
	default n
	---help---
		Enable support for smf_hw_stand
```

## src/examples/test_module/Kconfig
```kconfig
menuconfig EXAMPLES_TEST_MODULE
 bool "test_module"
 default n
 ---help---
     Enable support for test_module
```
